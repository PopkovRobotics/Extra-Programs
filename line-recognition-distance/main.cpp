/*
 * Программа реализует движение модели по правому краю чёрной линии
 * с П-регулятором, в течение 3 метров.
 */

/*
 * Подключаем библиотеку для отправки параметров движения
 * модели на контроллер Arduino.
 * Параметры движения - это угол поврота передних колёс, скрость модели
 * и направление движения.
 */
#include "Arduino.hpp"
// Подключаем библиотеку для чтения видео с вебкамеры модели.
#include "Webcam.hpp"
// X координата правого края линии, к оторому стремиться преблизиться модель
#define CENTER              340
// Ширина кадров в пикселях, которые будут считываться с вебкамеры
#define WIDTH_FRAME         640
// Высота кадров в пикселях, которые будут считываться с вебкамеры
#define HEIGHT_FRAME        480

/*
 * Функция реализует нахождение чёрной линии на изображении.
 * Функция возвращает x координату правого края чёрной линии.
 * frame - изображение, на котором ведётся поиск чёрной линии.
 * scan_row - номер строки на изображение, на котором ведётся поиск
 * чёрной линии.
 * old_center_line - x координата правого края линии, найденный ранее.
 */
int recognitionLine(int*** frame, int scan_row, int old_center_line) {
    // !ВНИМАНИЕ! для определения чёрного цвета используется только красная компонента
    // Для получения цвета пкиселя на изображение необходимо использовать следующюю запись:
    // frame[x][y][dims], где:
    // x - x координата пикселя на изображение
    // y - y координата пикселя на изображение
    // dims - номер цветового компонента пикселя

    int line_center = CENTER,
        right_border = 0,
        left_border = 0;

    // Если линия раньше не была найденна, то ищем её по всему кадру
    if (old_center_line == -1) {
        // Ищем чёрную линию
        int i = 380;
        for(; i > 0; i--) {
            if(frame[i][scan_row][2] < 140) break;
        }
        right_border = i;
        for(; i > 0; i--) {
            if(frame[i][scan_row][2] < 40) break;
        }
        left_border = i + 1;
    }
    // Если чёрная линия была найденна ранее, то ищем её далее
    // по x координате правого края найденной ранее
    else{
        // Ищем чёрную линию
        int i = old_center_line;
        for(; i < 640; i++){
            if(frame[i][scan_row][2] > 140) break;
        }
        right_border = i - 1;
        i = right_border;
        for(; i > 0; i--){
            if(frame[i][scan_row][2] < 40) break;
        }
        left_border = i + 1;
    }

    // Рассчитаем x координату правого края линия
    line_center = (left_border + right_border) / 2;

    return line_center;
}

int main() {
    // Угол поврота передних колёс модели
    // 90 градусов - передние колёса стоят прямо
    // > 90 градусов - передние колёса повёрнуты влево
    // < 90 градусов - передние колёса повёрнуты право
    // !ВНИМАНИЕ! не ставьте угол колёс больше 120 градусов, и не меньше 60 градусов
    int angle = 90,
    // X координата правого края чёрной линии
        center_line = -1;
    // Дистанция пройденная моделью в см
    double distance = 0.0,
    // Дистанция пройденная моделью при запуске программы
          start_distance = 0.0;
    // Флаг, определяющий в первый раз выполняется ли код
    bool start = true;
    // Массив, в котором хранится команда с параметрами движения модели,
    // отправляемая на Arduino
    char message[128];
    // Трёхмерный массив, в который будет записываться кадр считанный с вебкамеры моделью
    // Кадр хранится в формате BGR (Blue-Green-Red),
    int*** frame;
    // Создаём экземпляр класса для работы с Arduino
    ArduinoCtrl controller(
                    "/dev/ttyS3");                          // Порт, к которому подключена контроллер Arduino
    // Создаём экземпляр класса для чтения кадров с вебкамеры
    Webcam webcam("/dev/video0",                            // Порт, к которому подключена вебкамеры модели
    // Размер кадров, которые будут считываться с вебкамеры
                  WIDTH_FRAME,                              // Ширина кадра
                  HEIGHT_FRAME);                            // Высота кадра

    while(true) {
        // Получаем кадр с вебкамеры
        frame = webcam.frame();

        // Ищем чёрную линию на изображение
        center_line = recognitionLine(frame,
                                      470,                  // Номер строки на изображение, на которой ведётся поиск чёрной линии
                                      center_line);         // X координата правого края линии, найденный ранее

        // Находим разницу между рассчитаной координатой правого края линии и идеальной координатой
        float error = CENTER - center_line;
        // Рассчитываем угол поворота передних колёс
        angle = (float)90.0 + error;
        // Ограничиваем угол поворота передних колёс
        // Смотрит, чтобы угол поворота не был больше 120 градусов и меньше 60 градусов
        if(angle > 120) angle = 120;
        if(angle < 60) angle = 60;

        // Создаём команду с параметрами движения модели для отправки на Arduino
        snprintf(message, sizeof(message), "SPD %d,%d,%d ",
                 angle,                                     // Угол поворота передних колёс
                 1,                                         // Направление движения
                                                            // (1 - модель едет вперёд, 0 - машинка едет назад)
                 30);                                       // Скорость движения модели в см/c. Максимальная скорость 60см/c.
                                                            // !ВНИМАНИЕ! модель начинает ехать, только при скорости 27см/c.

        // Отправляем команду на Arduino
        controller.SendCommand(message,                     // Команда, записанная в массиве char
                               strlen(message));            // Размер массива в байтах


        if(start) {
            // !ВНИМАНИЕ! При запуске программы на одноплатном микрокомпьютере, дистанция
            // пройденная моделью может быть не нулевой, так как пройденная дистанция сохраняется на Arduino.
            // Поэтому, чтобы узнать дистанцию пройденную моделью с начала запуска программы, необходимо из дистанции полученной в начале программы 
            // вычитать нынешнию дистанцию.
            // Получаем дистанцию пройденную моделью при запсуке программы
            controller.GetDistance(start_distance);         // В данную переменную записывается дистанция
                                                            // пройденная моделью в см.
            start = false;
        }else{
            // Получаем дистанцию пройденную моделью
            controller.GetDistance(distance);               // В данную переменную записывается дистанция
                                                            // пройденная моделью в см.
        }

        // Если проехали 300см (3м), с начала запуска программы,
        // то выходим из цикла
        if((distance - start_distance) >= 300) break;
    }

    // Завершаем программу
    return 0;
}
