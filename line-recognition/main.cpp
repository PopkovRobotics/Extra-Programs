/*
 * Программа реализует движение модели по правому краю чёрной линии
 * с П-регулятором.
 */

/*
 * Подключаем библиотеку для отправки параметров движения
 * модели на контроллер Arduino.
 * Параметры движения - это угол поворота передних колёс, скорость модели
 * и направление движения.
 */
#include "Arduino.hpp"
// Подключаем библиотеку для чтения видео с вебкамеры модели.
#include "Webcam.hpp"
// Ширина кадров в пикселях, которые будут считываться с вебкамеры
#define WIDTH_FRAME         640
// Высота кадров в пикселях, которые будут считываться с вебкамеры
#define HEIGHT_FRAME        480

int main() {
    // Угол поврота передних колёс модели
    // 90 градусов - передние колёса стоят прямо
    // > 90 градусов - передние колёса повёрнуты влево
    // < 90 градусов - передние колёса повёрнуты право
    // !ВНИМАНИЕ! не ставьте угол колёс больше 120 градусов, и не меньше 60 градусов
    int angle = 90;
    // Массив, в котором хранится команда с параметрами движения модели,
    // отправляемая на Arduino
    char message[128];
    // Трёхмерный массив, в который будет записываться кадр считанный с вебкамеры моделью
    // Кадр хранится в формате BGR (Blue-Green-Red),
    int*** frame;
    // Создаём экземпляр класса для работы с Arduino
    ArduinoCtrl controller(
                    "/dev/ttyS3");                          // Порт, к которому подключена контроллер Arduino
    // Создаём экземпляр класса для чтения кадров с вебкамеры
    Webcam webcam("/dev/video0",                            // Порт, к которому подключена вебкамеры модели
    // Размер кадров, которые будут считываться с вебкамеры
                  WIDTH_FRAME,                              // Ширина кадра
                  HEIGHT_FRAME);                            // Высота кадра

    while(true) {
        // Получаем кадр с вебкамеры
        frame = webcam.frame();
        
        int blue_pixels = 0,                                // Количество синих пикселей на изображение
            white_pixels = 0,                               // Количество белых пикселей на изображение
            red_pixels = 0;                                 // Количество красных пикселей на изображение
            
        // Сканируем центр изображения
        for(int y = 235; y < (235 + 10); y++) {
            for(int x = 315; x < (315 + 10); x++) {
                // Получаем красную, зелёную, синюю компоненту пикселя
                int red = frame[x][y][2],                   // Красная компоненты
                    green = frame[x][y][1],                 // Зелёная компоненты
                    blue = frame[x][y][0];                  // Синяя компонента
                    
                // Определяем цвет пикселя
                if(red > 128 && green > 128 && blue > 128) {
                    // Если пиксель белый
                    white_pixels++;
                }
                if(red > (green + blue)) {
                    // Если пиксель красный
                    red_pixels++;
                }
                if(blue > (red + green)) {
                    // Если пиксель синий
                    blue_pixels++;
                }
            }
        }
            
        if(blue_pixels > 90) {
            // Если в вебкамеру модели показан синий лист бумаги
            // то поворачиваем передние колёса модели налево
            angle = 120;
        }else if(red_pixels > 90) {
            // Если в вебкамеру модели показан красный лист бумаги
            // то поворачиваем передние колёса модели направо
            angle = 60;
        }else if(white_pixels > 90) {
            // Если в вебкамеру модели показан белый лист бумаги,
            // то поворачиваем передние колёса модели прямо
            angle = 90;
        }

        // Создаём команду с параметрами движения модели для отправки на Arduino
        snprintf(message, sizeof(message), "SPD %d,%d,%d ",
                 angle,                                     // Угол поворота передних колёс
                 1,                                         // Направление движения
                                                            // (1 - модель едет вперёд, 0 - машинка едет назад)
                 30);                                       // Скорость движения модели в см/c. Максимальная скорость 60см/c.
                                                            // !ВНИМАНИЕ! модель начинает ехать, только при скорости 27см/c.

        // Отправляем команду на Arduino
        controller.SendCommand(message,                     // Команда, записанная в массиве char
                               strlen(message));            // Размер массива в байтах
    }

    // Завершаем программу
    return 0;
}
